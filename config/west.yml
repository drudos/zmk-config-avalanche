## config/west.yml
```yaml
manifest:
  remotes:
    - name: zmkfirmware
      url-base: https://github.com/zmkfirmware
    - name: drudos
      url-base: https://github.com/drudos
  projects:
    - name: zmk
      remote: drudos
      revision: my-changes/split-encoder
      import: app/west.yml
  self:
    path: config
```
